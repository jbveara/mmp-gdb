## Anchor_A1/mmp-gdb/Kconfig/boards/Kconfig.tmp
```kconfig
# Load Zephyr board Kconfig descriptions.
osource "C:/ncs/v3.3.1/zephyr/boards/nordic/nrf52840dk/Kconfig"
```

## Anchor_A2/Kconfig/Kconfig.shield
```kconfig
osource "C:/SPL/zephyr-dw3000-examples/dw3000-decadriver/zephyr/boards/shields/*/Kconfig.shield"
osource "C:/ncs/v3.3.1/nrf/boards/shields/*/Kconfig.shield"
```
