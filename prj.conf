## CMakeLists.txt
```
# SPDX-License-Identifier: Apache-2.0
cmake_minimum_required(VERSION 3.20.0)

list(APPEND ZEPHYR_EXTRA_MODULES
    ${CMAKE_CURRENT_SOURCE_DIR}/../zephyr-dw3000-examples/dw3000-decadriver/
)

find_package(Zephyr REQUIRED HINTS $ENV{ZEPHYR_BASE})
project(mmp-gdb)

zephyr_library_compile_options(-O1)

# Pull ROLE from sysbuild context into this image cmake context
zephyr_get(ROLE SYSBUILD GLOBAL)

#if(ROLE STREQUAL "ANCHOR_A1")
#    add_definitions(-DROLE_ANCHOR_A1)
#    message(STATUS "MMP-GDB role: ANCHOR_A1")
#elseif(ROLE STREQUAL "ANCHOR_A2")
#    add_definitions(-DROLE_ANCHOR_A2)
#    message(STATUS "MMP-GDB role: ANCHOR_A2")
#elseif(ROLE STREQUAL "ANCHOR_A3")
#    add_definitions(-DROLE_ANCHOR_A3)
#    message(STATUS "MMP-GDB role: ANCHOR_A3")
#else()
#    message(FATAL_ERROR "No role defined. Add CMake arg: -Dmmp-gdb_ROLE=ANCHOR_A1 (or A2/A3)")
#endif()

target_sources(app PRIVATE
    src/main.c
    src/ring_exchange.c
    ../zephyr-dw3000-examples/platform/port.c
    ../zephyr-dw3000-examples/platform/config_options.c
    ../zephyr-dw3000-examples/examples/shared_data/shared_functions.c
)

target_include_directories(app PRIVATE
    src
    ../zephyr-dw3000-examples/platform
    ../zephyr-dw3000-examples/examples/shared_data
)
```

## sysbuild.conf
```
SB_CONFIG_BOOTLOADER_NONE=y
```

## prj.conf
```kconfig
# MMP-GDB project config — Zephyr Shell interface
CONFIG_DW3000=y
CONFIG_SPI=y

CONFIG_NEWLIB_LIBC=y

# Shell over UART console — handles all RX input, no custom UART driver needed.
# CONFIG_SHELL=y automatically enables CONFIG_SHELL_BACKEND_SERIAL=y and
# CONFIG_UART_CONSOLE=y on the nRF52840DK.
CONFIG_SHELL=y

# Route log output through the shell backend so log noise doesn't corrupt
# TS lines. Shell ensures log messages are safely interleaved with output.
CONFIG_LOG=y
CONFIG_LOG_MODE_MINIMAL=y
CONFIG_SHELL_LOG_BACKEND=y

# Disable RTT — all comms through UART/shell
CONFIG_RTT_CONSOLE=n
CONFIG_USE_SEGGER_RTT=n

# Heap for dynamic buffers
CONFIG_HEAP_MEM_POOL_SIZE=4096

CONFIG_FPU=y
CONFIG_FPU_SHARING=y
CONFIG_CBPRINTF_FP_SUPPORT=y

CONFIG_SERIAL=y
```

## src/main.c
```c
/*
 * main.c — MMP-GDB ring exchange, Zephyr Shell interface.
 *
 * The Zephyr shell runs on the UART console and handles all RX input.
 * Two shell commands are registered:
 *
 *   role <1|2|3>   — set role at runtime (1=A1, 2=A2, 3=A3)
 *   start          — initialise DW3000 and begin operation
 *
 * Output lines (TS,... ERR,... INF,...) are written with printk() and
 * appear interleaved with the shell prompt — anchor.py filters them by
 * prefix, ignoring "uart:~$" prompt lines.
 *
 * Requires in prj.conf:
 *   CONFIG_SHELL=y
 *   CONFIG_SHELL_BACKEND_SERIAL=y   (default when CONFIG_SHELL=y on UART)
 *
 * Shell log backend (CONFIG_LOG_BACKEND_SHELL) replaces the UART log
 * backend so log noise doesn't corrupt TS lines on a separate channel.
 */

#include <zephyr/kernel.h>
#include <zephyr/sys/printk.h>
#include <zephyr/shell/shell.h>
#include <string.h>
#include <stdlib.h>

#include <dw3000_hw.h>
#include "deca_probe_interface.h"
#include "deca_device_api.h"
#include "deca_interface.h"
#include "port.h"
#include "node_config.h"
#include "ring_exchange.h"

/* ---------------------------------------------------------------------------
 * Shared state between shell commands and the main thread.
 * Protected by a semaphore — shell commands run in the shell thread.
 * -------------------------------------------------------------------------*/
static anchor_role_t g_role   = ROLE_NONE;
static bool          g_start  = false;
static bool          g_hw_ok  = false;

/* Semaphore: main thread blocks on it; "start" command gives it. */
K_SEM_DEFINE(start_sem, 0, 1);

/* ---------------------------------------------------------------------------
 * Shell command: role <1|2|3>
 * -------------------------------------------------------------------------*/
static int cmd_role(const struct shell *sh, size_t argc, char **argv)
{
    if (argc != 2) {
        shell_error(sh, "Usage: role <1|2|3>");
        return -EINVAL;
    }

    int r = atoi(argv[1]);
    if (r < 1 || r > 3) {
        shell_error(sh, "Invalid role %d — use 1 (A1), 2 (A2), or 3 (A3)", r);
        return -EINVAL;
    }

    g_role = (anchor_role_t)r;
    const char *names[] = { "", "A1 (initiator)", "A2 (responder)", "A3 (responder)" };
    shell_print(sh, "INF,role_set_%s", names[r]);
    return 0;
}

/* ---------------------------------------------------------------------------
 * Shell command: start
 * -------------------------------------------------------------------------*/
static int cmd_start(const struct shell *sh, size_t argc, char **argv)
{
    ARG_UNUSED(argc);
    ARG_UNUSED(argv);

    if (g_role == ROLE_NONE) {
        shell_error(sh, "Set role first: role <1|2|3>");
        return -EINVAL;
    }

    if (g_start) {
        shell_error(sh, "Already started");
        return -EALREADY;
    }

    g_start = true;
    shell_print(sh, "INF,starting");
    k_sem_give(&start_sem);
    return 0;
}

/* Register commands — available as soon as the shell starts */
SHELL_CMD_ARG_REGISTER(role,  NULL, "Set anchor role: role <1|2|3>", cmd_role,  2, 0);
SHELL_CMD_REGISTER    (start, NULL, "Start UWB operation",            cmd_start);

/* ---------------------------------------------------------------------------
 * main — waits for shell commands, then runs UWB protocol
 * -------------------------------------------------------------------------*/
int main(void)
{
    printk("INF,MMP-GDB_ready — type: role <1|2|3>  then: start\n");

    /* Block until the shell "start" command gives the semaphore */
    k_sem_take(&start_sem, K_FOREVER);

    ring_set_role(g_role);

    /* ---- Hardware init --------------------------------------------------- */
    dw3000_hw_init();
    dw3000_hw_reset();
    Sleep(2);

    dwt_probe((struct dwt_probe_s *)&dw3000_probe_interf);

    if (dwt_initialise(DWT_DW_INIT) == DWT_ERROR) {
        printk("ERR,0,dwt_initialise_failed\n");
        return -1;
    }

    if (ring_init() != 0) {
        printk("ERR,0,ring_init_failed\n");
        return -1;
    }

    g_hw_ok = true;

    /* ---- Run ------------------------------------------------------------- */
    if (g_role == ROLE_A1) {
        round_timestamps_t rt;
        printk("INF,A1_starting_period_%ums\n", ROUND_PERIOD_MS);
        while (1) {
            if (ring_run_round(&rt) == 0) {
                ring_print_timestamps(&rt);
            } else {
                printk("ERR,%u,round_failed\n", rt.seq);
            }
            k_msleep(ROUND_PERIOD_MS);
        }
    } else {
        ring_responder_loop(); /* never returns */
    }

    return 0;
}
```

## src/node_config.h
```c
#ifndef NODE_CONFIG_H
#define NODE_CONFIG_H

/* ---------------------------------------------------------------------------
 * Role is selected at RUNTIME via UART command "ROLE=<1|2|3>\n".
 * There are no compile-time ROLE_ANCHOR_A1/A2/A3 defines in this build.
 * The single firmware binary is flashed to all three boards.
 * -------------------------------------------------------------------------*/

/* ---------------------------------------------------------------------------
 * UWB short addresses
 * -------------------------------------------------------------------------*/
#define ADDR_A1  0x0001U
#define ADDR_A2  0x0002U
#define ADDR_A3  0x0003U
#define ADDR_PAN 0xDECAU

/* ---------------------------------------------------------------------------
 * UWB PHY config — channel 5, 6.8 Mbps
 * -------------------------------------------------------------------------*/
#define UWB_CHANNEL      5
#define UWB_PREAM_CODE   9
#define UWB_SFD_TIMEOUT  (128 + 1 + 8)

/* ---------------------------------------------------------------------------
 * Antenna delays
 * -------------------------------------------------------------------------*/
#define TX_ANT_DLY  16399U
#define RX_ANT_DLY  16399U

/* ---------------------------------------------------------------------------
 * Reply delay — programmed by responder hardware; also used by host Python
 * to reconstruct the nominal delta.  Must match on both sides.
 *
 * RESP_TX_DELAY_TICKS : raw ticks loaded into the DX_TIME register offset
 * DELTA_TICKS         : the actual stamped delta = RESP_TX_DELAY_TICKS + TX_ANT_DLY
 *                       (see node_config.h in the original codebase for derivation)
 *
 * These values are also printed in the RDY line so the host can verify them.
 * -------------------------------------------------------------------------*/
#define RESP_TX_DELAY_TICKS  192000000ULL
#define DELTA_TICKS          (RESP_TX_DELAY_TICKS + TX_ANT_DLY)

/* A1 RX timeout — covers two hops of delay plus margin */
#define RX_TIMEOUT_UUS  20000U

/* Interval between complete rounds (A1 side) */
#define ROUND_PERIOD_MS  500U

/* ---------------------------------------------------------------------------
 * Frame layout
 * -------------------------------------------------------------------------*/
#define FRAME_FC_IDX       0
#define FRAME_SEQ_IDX      1
#define FRAME_PAN_IDX      2
#define FRAME_DEST_IDX     4
#define FRAME_SRC_IDX      6
#define FRAME_PAYLOAD_IDX  8

#define ADDR_BROADCAST  0xFFFFU

/* Function codes */
#define FC_MSG1  0x31U
#define FC_MSG2  0x32U
#define FC_MSG3  0x33U
#define FC_MSG4  0x34U
#define FC_MSG5  0x35U
#define FC_MSG6  0x36U

#define FRAME_MAX_PAYLOAD  25U
#define FRAME_LEN_MAX_APP  (FRAME_PAYLOAD_IDX + FRAME_MAX_PAYLOAD + 2U)

#endif /* NODE_CONFIG_H */
```

## src/ring_distances.c
```c
/*
 * ring_distances.c — MMP-GDB distance computation
 *
 * Each node calls ring_calc_distances() after a complete round.
 * Every node observes all 6 broadcasts, so each has its own set of
 * 6 locally-measured timestamps and applies the column formula for its role.
 *
 * Timestamp array layout:
 *   ts[0]=Msg1  ts[1]=Msg2  ts[2]=Msg3  ts[3]=Msg4  ts[4]=Msg5  ts[5]=Msg6
 *
 *   A1: TX1  RX2  RX3  TX4  RX5  RX6
 *   A2: RX1  TX2  RX3  RX4  RX5  TX6
 *   A3: RX1  RX2  TX3  RX4  TX5  RX6
 *
 * Delta handling
 * --------------
 * Every responder programs its TX delay using RESP_TX_DELAY_TICKS directly
 * in raw 40-bit tick space (see send_delayed in ring_exchange.c).  The
 * hardware therefore stamps TX ≈ RX_trigger + RESP_TX_DELAY_TICKS, with the
 * only error being the ≤256-tick sub-byte rounding of the TX register
 * (~1.2 mm worst case).  Using the same constant here means the formula
 * delta always matches what was actually stamped — no per-board calibration,
 * no crystal-frequency correction needed.
 *
 * DWT tick period ≈ 1 / (499.2 MHz × 128) ≈ 15.65 ps
 * Speed of light:  299,792,458 m/s
 */

#include "ring_distances.h"
#include "node_config.h"

#include <zephyr/sys/printk.h>

/* ---------------------------------------------------------------------------
 * Physical constants
 * -------------------------------------------------------------------------*/
#define DWT_FREQ_HZ         (499.2e6 * 128.0)
#define SPEED_OF_LIGHT_MPS   299792458.0
#define METRES_PER_TICK     (SPEED_OF_LIGHT_MPS / DWT_FREQ_HZ)

/* Single shared delta — RESP_TX_DELAY_TICKS + TX_ANT_DLY matches what
 * predicted_tx_ts actually stamps (see node_config.h for derivation). */
#define D  ((double)DELTA_TICKS)

/* Guard: reject ToF outside [0, 300 m] */
#define TOF_MAX_TICKS  (300.0 / METRES_PER_TICK)

/* ---------------------------------------------------------------------------
 * ring_calc_distances
 * -------------------------------------------------------------------------*/
int ring_calc_distances(const round_timestamps_t *rt, ring_distances_t *dist)
{
    if (!rt || !rt->valid || !dist) {
        return -1;
    }

    const double T1 = (double)rt->ts[0];
    const double T2 = (double)rt->ts[1];
    const double T3 = (double)rt->ts[2];
    const double T4 = (double)rt->ts[3];
    const double T5 = (double)rt->ts[4];
    const double T6 = (double)rt->ts[5];

    int ret = 0;

#if defined(ROLE_ANCHOR_A1)
    /*
     * A1 timestamps: TX1  RX2  RX3  TX4  RX5  RX6
     *
     * tof_P1P2: A2 replied to Msg1 with delay D
     *   RX2 - TX1 = 2·tof_P1P2 + D
     *   tof_P1P2 = (RX2 - TX1 - D) / 2
     *
     * tof_P1P3: A3 replied to Msg4 with delay D
     *   RX5 - TX4 = 2·tof_P1P3 + D
     *   tof_P1P3 = (RX5 - TX4 - D) / 2
     *
     * tof_P2P3: A2 replied to Msg5 (from A3) with delay D.
     *   RX6 = TX4 + tof_P1P3 + D + tof_P2P3 + D + tof_P1P2
     *   tof_P2P3 = (RX6 - TX4) - tof_P1P3 - tof_P1P2 - 2D
     */
    double tof_P1P2 = (T2 - T1 - D) / 2.0;
    double tof_P1P3 = (T5 - T4 - D) / 2.0;
    double tof_P2P3 = (T6 - T4) - tof_P1P3 - tof_P1P2 - 2.0*D;

    if (tof_P1P2 < -500.0 || tof_P1P2 > TOF_MAX_TICKS) {
        printk("A1: tof_P1P2 out of range (%.1f ticks)\n", tof_P1P2);
        dist->d_P1P2 = -1.0; ret = -1;
    } else {
        dist->d_P1P2 = (tof_P1P2 < 0.0 ? 0.0 : tof_P1P2) * METRES_PER_TICK;
    }

    if (tof_P1P3 < -500.0 || tof_P1P3 > TOF_MAX_TICKS) {
        printk("A1: tof_P1P3 out of range (%.1f ticks)\n", tof_P1P3);
        dist->d_P1P3 = -1.0; ret = -1;
    } else {
        dist->d_P1P3 = (tof_P1P3 < 0.0 ? 0.0 : tof_P1P3) * METRES_PER_TICK;
    }

    if (tof_P2P3 < -500.0 || tof_P2P3 > TOF_MAX_TICKS) {
        printk("A1: tof_P2P3 out of range (%.1f ticks)\n", tof_P2P3);
        dist->d_P2P3 = -1.0; ret = -1;
    } else {
        dist->d_P2P3 = (tof_P2P3 < 0.0 ? 0.0 : tof_P2P3) * METRES_PER_TICK;
    }

    printk("A1 seq=%u  d_P1P2=%.3f m  d_P1P3=%.3f m  d_P2P3=%.3f m\n",
           rt->seq, dist->d_P1P2, dist->d_P1P3, dist->d_P2P3);

#elif defined(ROLE_ANCHOR_A2)
    /*
     * A2 timestamps: RX1  TX2  RX3  RX4  RX5  TX6
     *
     * tof_P2P3: A3 replied to Msg2 with delay D
     *   RX3 - TX2 = 2·tof_P2P3 + D
     *   tof_P2P3 = (RX3 - TX2 - D) / 2
     *
     * tof_P1P3: tof(A3→A2) cancels in RX5-RX3 (both sent by A3),
     *   leaving TX5_A3 - TX3_A3 = 2·tof_P1P3 + 2D
     *   tof_P1P3 = (RX5 - RX3 - 2D) / 2
     *
     * tof_P1P2: A1 sent Msg4 after receiving Msg3 with delay D.
     *   RX4 = TX2 + tof_P2P3 + D + tof_P1P3 + D + tof_P1P2
     *   tof_P1P2 = (RX4 - TX2) - tof_P2P3 - tof_P1P3 - 2D
     */
    double tof_P2P3 = (T3 - T2 - D) / 2.0;
    double tof_P1P3 = (T5 - T3 - 2.0*D) / 2.0;
    double tof_P1P2 = (T4 - T2) - tof_P2P3 - tof_P1P3 - 2.0*D;

    if (tof_P2P3 < -500.0 || tof_P2P3 > TOF_MAX_TICKS) {
        printk("A2: tof_P2P3 out of range (%.1f ticks)\n", tof_P2P3);
        dist->d_P2P3 = -1.0; ret = -1;
    } else {
        dist->d_P2P3 = (tof_P2P3 < 0.0 ? 0.0 : tof_P2P3) * METRES_PER_TICK;
    }

    if (tof_P1P3 < -500.0 || tof_P1P3 > TOF_MAX_TICKS) {
        printk("A2: tof_P1P3 out of range (%.1f ticks)\n", tof_P1P3);
        dist->d_P1P3 = -1.0; ret = -1;
    } else {
        dist->d_P1P3 = (tof_P1P3 < 0.0 ? 0.0 : tof_P1P3) * METRES_PER_TICK;
    }

    if (tof_P1P2 < -500.0 || tof_P1P2 > TOF_MAX_TICKS) {
        printk("A2: tof_P1P2 out of range (%.1f ticks)\n", tof_P1P2);
        dist->d_P1P2 = -1.0; ret = -1;
    } else {
        dist->d_P1P2 = (tof_P1P2 < 0.0 ? 0.0 : tof_P1P2) * METRES_PER_TICK;
    }

    printk("A2 seq=%u  d_P1P2=%.3f m  d_P1P3=%.3f m  d_P2P3=%.3f m\n",
           rt->seq, dist->d_P1P2, dist->d_P1P3, dist->d_P2P3);

#elif defined(ROLE_ANCHOR_A3)
    /*
     * A3 timestamps: RX1  RX2  TX3  RX4  TX5  RX6
     *
     * tof_P1P3: A1 replied to Msg3 with delay D
     *   RX4 - TX3 = 2·tof_P1P3 + D
     *   tof_P1P3 = (RX4 - TX3 - D) / 2
     *
     * tof_P2P3: A2 replied to Msg5 with delay D
     *   RX6 - TX5 = 2·tof_P2P3 + D
     *   tof_P2P3 = (RX6 - TX5 - D) / 2
     *
     * tof_P1P2: no D terms — pure timestamp geometry, D cancels.
     *   tof_P1P2 = (RX2 - RX1) + (RX4 - RX6) / 2
     *   Crystal offset does not bias this term. Small negatives
     *   (<1000 ticks, ~5 mm) are sub-register jitter, clamped to zero.
     */
    double tof_P1P3 = (T4 - T3 - D) / 2.0;
    double tof_P2P3 = (T6 - T5 - D) / 2.0;
    double tof_P1P2 = (T2 - T1) + (T4 - T6) / 2.0;

    if (tof_P1P3 < -500.0 || tof_P1P3 > TOF_MAX_TICKS) {
        printk("A3: tof_P1P3 out of range (%.1f ticks)\n", tof_P1P3);
        dist->d_P1P3 = -1.0; ret = -1;
    } else {
        dist->d_P1P3 = (tof_P1P3 < 0.0 ? 0.0 : tof_P1P3) * METRES_PER_TICK;
    }

    if (tof_P2P3 < -500.0 || tof_P2P3 > TOF_MAX_TICKS) {
        printk("A3: tof_P2P3 out of range (%.1f ticks)\n", tof_P2P3);
        dist->d_P2P3 = -1.0; ret = -1;
    } else {
        dist->d_P2P3 = (tof_P2P3 < 0.0 ? 0.0 : tof_P2P3) * METRES_PER_TICK;
    }

    if (tof_P1P2 < -1000.0 || tof_P1P2 > TOF_MAX_TICKS) {
        printk("A3: tof_P1P2 out of range (%.1f ticks)\n", tof_P1P2);
        dist->d_P1P2 = -1.0; ret = -1;
    } else {
        dist->d_P1P2 = (tof_P1P2 < 0.0 ? 0.0 : tof_P1P2) * METRES_PER_TICK;
    }

    printk("A3 seq=%u  d_P1P2=%.3f m  d_P1P3=%.3f m  d_P2P3=%.3f m\n",
           rt->seq, dist->d_P1P2, dist->d_P1P3, dist->d_P2P3);

#endif

    return ret;
}
```

## src/ring_distances.h
```c
#ifndef RING_DISTANCES_H
#define RING_DISTANCES_H

#include "ring_exchange.h"   /* round_timestamps_t */

/* ---------------------------------------------------------------------------
 * Distance results for one complete MMP-GDB round.
 *
 * All three pairwise distances are computed by every node independently
 * using only its own locally-observed timestamps and the known δ delay.
 * A value of -1.0 indicates a ranging error (negative or out-of-range ToF).
 * -------------------------------------------------------------------------*/
typedef struct {
    double d_P1P2;   /* A1 <-> A2, metres */
    double d_P1P3;   /* A1 <-> A3, metres */
    double d_P2P3;   /* A2 <-> A3, metres */
} ring_distances_t;

/* Compute distances from this node's locally-observed timestamps.
 * Applies the MMP-GDB column formula for the calling node's role
 * (selected at build time via ROLE_ANCHOR_A1/A2/A3).
 *
 * rt   — completed round_timestamps_t (rt->valid must be 1)
 * dist — output struct, always fully populated (–1.0 on error fields)
 *
 * Returns 0 if all three distances are valid, –1 if any ToF was bad. */
int ring_calc_distances(const round_timestamps_t *rt, ring_distances_t *dist);

#endif /* RING_DISTANCES_H */
```

## src/ring_exchange.c
```c
/*
 * ring_exchange.c
 * MMP-GDB 6-message bidirectional ring exchange — runtime role selection.
 *
 * Role is set at runtime via ring_set_role() (called from main.c after the
 * host sends "ROLE=<1|2|3>\n" over UART).  A single firmware binary is
 * flashed to all three boards.
 *
 * Distance computation has been removed entirely from the firmware.
 * After each round the node emits one "TS,..." line over UART; the host
 * Python application performs all distance math.
 *
 * Message sequence:
 *   Msg1: A1 → all   (forward initiation)
 *   Msg2: A2 → all   (forward hop 1)
 *   Msg3: A3 → all   (forward hop 2)
 *   Msg4: A1 → all   (reverse initiation)
 *   Msg5: A3 → all   (reverse hop 1)
 *   Msg6: A2 → all   (reverse hop 2 / round close)
 */

#include "ring_exchange.h"
#include "node_config.h"

#include <zephyr/kernel.h>
#include <zephyr/sys/printk.h>
#include <string.h>
#include <stddef.h>

#include "deca_device_api.h"
#include "deca_interface.h"
#include "shared_defines.h"
#include "shared_functions.h"
#include "port.h"
#include "config_options.h"

/* ---------------------------------------------------------------------------
 * Runtime role state
 * -------------------------------------------------------------------------*/
static anchor_role_t g_role = ROLE_NONE;

void ring_set_role(anchor_role_t role)
{
    g_role = role;
}

/* ---------------------------------------------------------------------------
 * DW3000 config
 * -------------------------------------------------------------------------*/
static dwt_config_t uwb_config = {
    .chan            = UWB_CHANNEL,
    .txPreambLength  = DWT_PLEN_128,
    .rxPAC           = DWT_PAC8,
    .txCode          = UWB_PREAM_CODE,
    .rxCode          = UWB_PREAM_CODE,
    .sfdType         = DWT_SFD_DW_8,
    .dataRate        = DWT_BR_6M8,
    .phrMode         = DWT_PHRMODE_STD,
    .phrRate         = DWT_PHRRATE_STD,
    .sfdTO           = UWB_SFD_TIMEOUT,
    .stsMode         = DWT_STS_MODE_OFF,
    .stsLength       = DWT_STS_LEN_64,
    .pdoaMode        = DWT_PDOA_M0,
};

/* ---------------------------------------------------------------------------
 * Frame buffers
 * -------------------------------------------------------------------------*/
static uint8_t tx_buf[FRAME_LEN_MAX_APP];
static uint8_t rx_buf[FRAME_LEN_MAX_APP];

static uint8_t seq_num = 0;

/* ---------------------------------------------------------------------------
 * Timestamp packing helpers (5-byte LE, DWT 40-bit counter)
 * -------------------------------------------------------------------------*/
static void pack_ts(uint8_t *buf, uint64_t ts)
{
    buf[0] = (uint8_t)(ts & 0xFF);
    buf[1] = (uint8_t)((ts >>  8) & 0xFF);
    buf[2] = (uint8_t)((ts >> 16) & 0xFF);
    buf[3] = (uint8_t)((ts >> 24) & 0xFF);
    buf[4] = (uint8_t)((ts >> 32) & 0xFF);
}

static uint64_t unpack_ts(const uint8_t *buf)
{
    return  (uint64_t)buf[0]        |
           ((uint64_t)buf[1] <<  8) |
           ((uint64_t)buf[2] << 16) |
           ((uint64_t)buf[3] << 24) |
           ((uint64_t)buf[4] << 32);
}

/* ---------------------------------------------------------------------------
 * Frame builder — broadcast destination
 * -------------------------------------------------------------------------*/
static uint8_t build_frame(uint8_t fc, uint16_t src,
                            const uint8_t *payload, uint8_t plen)
{
    memset(tx_buf, 0, sizeof(tx_buf));
    tx_buf[FRAME_FC_IDX]       = fc;
    tx_buf[FRAME_SEQ_IDX]      = seq_num;
    tx_buf[FRAME_PAN_IDX]      = (uint8_t)(ADDR_PAN & 0xFF);
    tx_buf[FRAME_PAN_IDX + 1]  = (uint8_t)(ADDR_PAN >> 8);
    tx_buf[FRAME_DEST_IDX]     = (uint8_t)(ADDR_BROADCAST & 0xFF);
    tx_buf[FRAME_DEST_IDX + 1] = (uint8_t)(ADDR_BROADCAST >> 8);
    tx_buf[FRAME_SRC_IDX]      = (uint8_t)(src & 0xFF);
    tx_buf[FRAME_SRC_IDX + 1]  = (uint8_t)(src >> 8);
    if (payload && plen) {
        memcpy(&tx_buf[FRAME_PAYLOAD_IDX], payload, plen);
    }
    return FRAME_PAYLOAD_IDX + plen + 2;
}

/* ---------------------------------------------------------------------------
 * TX helpers
 * -------------------------------------------------------------------------*/
static int send_immediate(uint8_t fc, uint16_t src,
                          const uint8_t *payload, uint8_t plen)
{
    uint8_t flen = build_frame(fc, src, payload, plen);
    dwt_writetxdata(flen, tx_buf, 0);
    dwt_writetxfctrl(flen, 0, 1);
    if (dwt_starttx(DWT_START_TX_IMMEDIATE) != DWT_SUCCESS) {
        printk("ERR,0,send_immediate_FC%02X\n", fc);
        return -1;
    }
    waitforsysstatus(NULL, NULL, DWT_INT_TXFRS_BIT_MASK, 0);
    dwt_writesysstatuslo(DWT_INT_TXFRS_BIT_MASK);
    return 0;
}

static int send_delayed(uint8_t fc, uint16_t src,
                        const uint8_t *payload, uint8_t plen,
                        uint64_t rx_ts, uint32_t *tx_time_out)
{
    uint32_t ref_time  = (uint32_t)(rx_ts >> 8);
    uint32_t dx_offset = (uint32_t)(RESP_TX_DELAY_TICKS >> 8);
    dwt_setreferencetrxtime(ref_time);
    dwt_setdelayedtrxtime(dx_offset);

    uint32_t tx_time = ref_time + dx_offset;
    if (tx_time_out) *tx_time_out = tx_time;

    uint8_t flen = build_frame(fc, src, payload, plen);
    dwt_writetxdata(flen, tx_buf, 0);
    dwt_writetxfctrl(flen, 0, 1);

    if (dwt_starttx(DWT_START_TX_DLY_REF) != DWT_SUCCESS) {
        printk("ERR,0,send_delayed_FC%02X\n", fc);
        /* Do NOT soft-reset here — caller will continue/return and the
         * responder loop will re-sync on the next Msg1 naturally. */
        return -1;
    }
    waitforsysstatus(NULL, NULL, DWT_INT_TXFRS_BIT_MASK, 0);
    dwt_writesysstatuslo(DWT_INT_TXFRS_BIT_MASK);
    return 0;
}

/* ---------------------------------------------------------------------------
 * RX helper
 * Returns FC byte on success, -1 on timeout/error.
 * -------------------------------------------------------------------------*/
static int wait_rx(uint64_t *rx_ts_out, int32_t *car_int_out)
{
    uint32_t status_lo = 0;
    dwt_setrxtimeout(RX_TIMEOUT_UUS);
    dwt_rxenable(DWT_START_RX_IMMEDIATE);

    waitforsysstatus(&status_lo, NULL,
                     DWT_INT_RXFCG_BIT_MASK | SYS_STATUS_ALL_RX_TO | SYS_STATUS_ALL_RX_ERR,
                     0);

    if (!(status_lo & DWT_INT_RXFCG_BIT_MASK)) {
        dwt_writesysstatuslo(SYS_STATUS_ALL_RX_TO | SYS_STATUS_ALL_RX_ERR);
        return -1;
    }

    uint16_t flen = dwt_getframelength();
    dwt_writesysstatuslo(DWT_INT_RXFCG_BIT_MASK);

    if (flen < FRAME_PAYLOAD_IDX + 2 || flen > FRAME_LEN_MAX_APP) {
        return -1;
    }
    dwt_readrxdata(rx_buf, flen - 2, 0);

    /* Basic PAN ID sanity check — reject frames from other networks */
    uint16_t pan = (uint16_t)rx_buf[FRAME_PAN_IDX] |
                   ((uint16_t)rx_buf[FRAME_PAN_IDX + 1] << 8);
    if (pan != ADDR_PAN) {
        return -1;
    }

    if (rx_ts_out) {
        uint64_t _ts = get_rx_timestamp_u64();
        memcpy(rx_ts_out, &_ts, sizeof(_ts));
    }
    if (car_int_out) {
        *car_int_out = dwt_readcarrierintegrator();
    }
    return rx_buf[FRAME_FC_IDX];
}

/* Compute predicted TX timestamp from the value written to the DX_TIME
 * register (bits[39:8]).  The hardware adds TX_ANT_DLY to the stamp. */
static uint64_t predicted_tx_ts(uint32_t tx_time)
{
    return (((uint64_t)(tx_time & 0xFFFFFFFEUL)) << 8) + TX_ANT_DLY;
}

/* ---------------------------------------------------------------------------
 * ring_init
 * -------------------------------------------------------------------------*/
int ring_init(void)
{
    if (g_role == ROLE_NONE) {
        printk("ERR,0,ring_init_no_role\n");
        return -1;
    }

    if (dwt_configure(&uwb_config) != DWT_SUCCESS) {
        printk("ERR,0,dwt_configure_failed\n");
        return -1;
    }

    dwt_setrxantennadelay(RX_ANT_DLY);
    dwt_settxantennadelay(TX_ANT_DLY);
    dwt_configureframefilter(DWT_FF_DISABLE, 0);

    /* Announce readiness to host.
     * Format: RDY,<role>,<DELTA_TICKS>,<TX_ANT_DLY>
     * The host uses DELTA_TICKS to verify its local constant matches. */
    printk("RDY,%u,%llu,%u\n",
           (unsigned)g_role,
           (unsigned long long)DELTA_TICKS,
           (unsigned)TX_ANT_DLY);

    return 0;
}

/* ---------------------------------------------------------------------------
 * ring_print_timestamps
 *
 * Emits one line consumed by the host Python app:
 *
 *   TS,<role>,<seq>,<ts0>,<ts1>,<ts2>,<ts3>,<ts4>,<ts5>,
 *      <ci0>,<ci1>,<ci2>,<ci3>,<ci4>,<ci5>
 *
 * All timestamps are unsigned 64-bit decimal.
 * car_int values are signed 32-bit decimal.
 * -------------------------------------------------------------------------*/
void ring_print_timestamps(const round_timestamps_t *rt)
{
    if (!rt->valid) {
        printk("ERR,%u,invalid_round\n", rt->seq);
        return;
    }
    printk("TS,%u,%u,"
           "%llu,%llu,%llu,%llu,%llu,%llu,"
           "%d,%d,%d,%d,%d,%d\n",
           (unsigned)g_role,
           (unsigned)rt->seq,
           (unsigned long long)rt->ts[0],
           (unsigned long long)rt->ts[1],
           (unsigned long long)rt->ts[2],
           (unsigned long long)rt->ts[3],
           (unsigned long long)rt->ts[4],
           (unsigned long long)rt->ts[5],
           rt->car_int[0],
           rt->car_int[1],
           rt->car_int[2],
           rt->car_int[3],
           rt->car_int[4],
           rt->car_int[5]);
}

/* ---------------------------------------------------------------------------
 * A1 — INITIATOR
 * Sends Msg1, listens for Msg2+Msg3, sends Msg4, listens for Msg5+Msg6.
 * -------------------------------------------------------------------------*/
__attribute__((noinline)) int ring_run_round(round_timestamps_t *rt)
{
    if (g_role != ROLE_A1) {
        return -1;
    }

    memset(rt, 0, sizeof(*rt));
    rt->seq = seq_num;

    /* Msg1: A1 → all */
    if (send_immediate(FC_MSG1, ADDR_A1, NULL, 0) != 0) return -1;
    rt->ts[0] = get_tx_timestamp_u64();   /* TX1 — car_int[0] unused (TX) */

    /* Msg2: listen for A2 */
    int fc = wait_rx(&rt->ts[1], &rt->car_int[1]);
    if (fc != FC_MSG2) {
        printk("ERR,%u,expected_MSG2_got_%02X\n", seq_num, (unsigned)fc);
        return -1;
    }

    /* Msg3: listen for A3 */
    fc = wait_rx(&rt->ts[2], &rt->car_int[2]);
    if (fc != FC_MSG3) {
        printk("ERR,%u,expected_MSG3_got_%02X\n", seq_num, (unsigned)fc);
        return -1;
    }

    /* Msg4: A1 → all (delayed from RX3) */
    uint32_t tx4_time;
    if (send_delayed(FC_MSG4, ADDR_A1, NULL, 0, rt->ts[2], &tx4_time) != 0) return -1;
    rt->ts[3] = predicted_tx_ts(tx4_time); /* TX4 — car_int[3] unused (TX) */

    /* Msg5: listen for A3 */
    fc = wait_rx(&rt->ts[4], &rt->car_int[4]);
    if (fc != FC_MSG5) {
        printk("ERR,%u,expected_MSG5_got_%02X\n", seq_num, (unsigned)fc);
        return -1;
    }

    /* Msg6: listen for A2 */
    fc = wait_rx(&rt->ts[5], &rt->car_int[5]);
    if (fc != FC_MSG6) {
        printk("ERR,%u,expected_MSG6_got_%02X\n", seq_num, (unsigned)fc);
        return -1;
    }

    rt->valid = 1;
    seq_num++;
    return 0;
}

/* ---------------------------------------------------------------------------
 * A2 — RESPONDER
 * Listens for Msg1, sends Msg2, listens for Msg3+Msg4+Msg5, sends Msg6.
 * -------------------------------------------------------------------------*/
static void run_a2(void)
{
    round_timestamps_t rt;

    while (true) {
        memset(&rt, 0, sizeof(rt));

        /* Msg1: wait for A1 */
        int fc = wait_rx(&rt.ts[0], &rt.car_int[0]);
        if (fc != FC_MSG1) continue;
        rt.seq = rx_buf[FRAME_SEQ_IDX];

        /* Msg2: A2 → all (delayed from RX1) */
        uint32_t tx2_time;
        if (send_delayed(FC_MSG2, ADDR_A2, NULL, 0, rt.ts[0], &tx2_time) != 0) continue;
        rt.ts[1] = predicted_tx_ts(tx2_time); /* TX2 — car_int[1] unused (TX) */

        /* Msg3: listen for A3 */
        fc = wait_rx(&rt.ts[2], &rt.car_int[2]);
        if (fc != FC_MSG3) {
            printk("ERR,%u,A2_expected_MSG3_got_%02X\n", rt.seq, (unsigned)fc);
            continue;
        }

        /* Msg4: listen for A1 */
        fc = wait_rx(&rt.ts[3], &rt.car_int[3]);
        if (fc != FC_MSG4) {
            printk("ERR,%u,A2_expected_MSG4_got_%02X\n", rt.seq, (unsigned)fc);
            continue;
        }

        /* Msg5: listen for A3 */
        fc = wait_rx(&rt.ts[4], &rt.car_int[4]);
        if (fc != FC_MSG5) {
            printk("ERR,%u,A2_expected_MSG5_got_%02X\n", rt.seq, (unsigned)fc);
            continue;
        }

        /* Msg6: A2 → all (delayed from RX5) */
        uint32_t tx6_time;
        if (send_delayed(FC_MSG6, ADDR_A2, NULL, 0, rt.ts[4], &tx6_time) != 0) continue;
        rt.ts[5] = predicted_tx_ts(tx6_time); /* TX6 — car_int[5] unused (TX) */

        rt.valid = 1;
        ring_print_timestamps(&rt);
    }
}

/* ---------------------------------------------------------------------------
 * A3 — RESPONDER
 * Listens for Msg1+Msg2, sends Msg3, listens for Msg4, sends Msg5, listens Msg6.
 * -------------------------------------------------------------------------*/
static void run_a3(void)
{
    round_timestamps_t rt;

    while (true) {
        memset(&rt, 0, sizeof(rt));

        /* Msg1: wait for A1 */
        int fc = wait_rx(&rt.ts[0], &rt.car_int[0]);
        if (fc != FC_MSG1) continue;
        rt.seq = rx_buf[FRAME_SEQ_IDX];

        /* Msg2: listen for A2 */
        fc = wait_rx(&rt.ts[1], &rt.car_int[1]);
        if (fc != FC_MSG2) {
            printk("ERR,%u,A3_expected_MSG2_got_%02X\n", rt.seq, (unsigned)fc);
            continue;
        }

        /* Msg3: A3 → all (delayed from RX2) */
        uint32_t tx3_time;
        if (send_delayed(FC_MSG3, ADDR_A3, NULL, 0, rt.ts[1], &tx3_time) != 0) continue;
        rt.ts[2] = predicted_tx_ts(tx3_time); /* TX3 — car_int[2] unused (TX) */

        /* Msg4: listen for A1 */
        fc = wait_rx(&rt.ts[3], &rt.car_int[3]);
        if (fc != FC_MSG4) {
            printk("ERR,%u,A3_expected_MSG4_got_%02X\n", rt.seq, (unsigned)fc);
            continue;
        }

        /* Msg5: A3 → all (delayed from RX4) */
        uint32_t tx5_time;
        if (send_delayed(FC_MSG5, ADDR_A3, NULL, 0, rt.ts[3], &tx5_time) != 0) continue;
        rt.ts[4] = predicted_tx_ts(tx5_time); /* TX5 — car_int[4] unused (TX) */

        /* Msg6: listen for A2 */
        fc = wait_rx(&rt.ts[5], &rt.car_int[5]);
        if (fc != FC_MSG6) {
            printk("ERR,%u,A3_expected_MSG6_got_%02X\n", rt.seq, (unsigned)fc);
            continue;
        }

        rt.valid = 1;
        ring_print_timestamps(&rt);
    }
}

/* ---------------------------------------------------------------------------
 * ring_responder_loop — dispatches to A2 or A3 based on runtime role.
 * Never returns.
 * -------------------------------------------------------------------------*/
void ring_responder_loop(void)
{
    if (g_role == ROLE_A2) {
        printk("INF,A2_listening\n");
        run_a2();
    } else if (g_role == ROLE_A3) {
        printk("INF,A3_listening\n");
        run_a3();
    } else {
        printk("ERR,0,responder_loop_called_on_non_responder\n");
    }
}
```

## src/ring_exchange.h
```c
#ifndef RING_EXCHANGE_H
#define RING_EXCHANGE_H

#include <stdint.h>

/* ---------------------------------------------------------------------------
 * Runtime role identifiers (set via ring_set_role() before ring_init())
 * -------------------------------------------------------------------------*/
typedef enum {
    ROLE_NONE = 0,
    ROLE_A1   = 1,   /* initiator */
    ROLE_A2   = 2,   /* responder */
    ROLE_A3   = 3,   /* responder */
} anchor_role_t;

/* ---------------------------------------------------------------------------
 * Per-node timestamp log for one complete MMP-GDB round (6 messages).
 *
 * ts[N] is a TX timestamp when this node sent message N+1, or an RX
 * timestamp when it received it.  car_int[N] holds the DW3000 carrier
 * integrator reading at each RX event; 0 for TX slots.
 *
 * Role      msg:  1     2     3     4     5     6
 * A1              TX1   RX2   RX3   TX4   RX5   RX6
 * A2              RX1   TX2   RX3   RX4   RX5   TX6
 * A3              RX1   RX2   TX3   RX4   TX5   RX6
 * -------------------------------------------------------------------------*/
typedef struct {
    uint8_t  valid;      /* 1 when all 6 messages completed successfully */
    uint8_t  seq;        /* round sequence number */
    uint64_t ts[6];      /* ts[0]=msg1 .. ts[5]=msg6 */
    int32_t  car_int[6]; /* carrier integrator at each RX; 0 for TX slots */
} round_timestamps_t;

/* ---------------------------------------------------------------------------
 * Public API
 * -------------------------------------------------------------------------*/

/* Set role before calling ring_init(). */
void ring_set_role(anchor_role_t role);

/* Initialise DW3000 for the configured role. Call after dwt_initialise(). */
int ring_init(void);

/* A1 only: run one complete round.  Fills *rt on success.
 * Returns 0 on success, -1 on error/timeout. */
__attribute__((noinline)) int ring_run_round(round_timestamps_t *rt);

/* A2/A3 only: blocking responder loop.  Never returns. */
void ring_responder_loop(void);

/* Emit one TS line to UART for the host. */
void ring_print_timestamps(const round_timestamps_t *rt);

#endif /* RING_EXCHANGE_H */
```
